## conf/distro/kryptonite.conf
```bitbake
require conf/distro/poky-bleeding.conf

DISTRO = "kryptonite"
DISTROOVERRIDES = "poky"
DISTRO_NAME = "Kryptonite (Yocto Project WSL Distro)"
DISTRO_VERSION = "3.1.3"
DISTRO_CODENAME = "dunfell"
SDK_VENDOR = "-kryptonitesdk"
SDK_VERSION = "${@d.getVar('DISTRO_VERSION').replace('snapshot-${DATE}', 'snapshot')}"

MAINTAINER = "TheYoctoJester <jester@theyoctojester.info>"

TARGET_VENDOR = "-kryptonite"

# Override these in poky based distros
POKY_DEFAULT_DISTRO_FEATURES = "largefile ptest multiarch"
POKY_DEFAULT_EXTRA_RDEPENDS = ""
POKY_DEFAULT_EXTRA_RRECOMMENDS = ""

TCLIBC = "musl"
INIT_MANAGER = "none"
```

## conf/layer.conf
```bitbake
# We have a conf and classes directory, add to BBPATH
BBPATH .= ":${LAYERDIR}"

# We have recipes-* directories, add to BBFILES
BBFILES += "${LAYERDIR}/recipes-*/*/*.bb \
            ${LAYERDIR}/recipes-*/*/*.bbappend"

BBFILE_COLLECTIONS += "meta-kryptonite"
BBFILE_PATTERN_meta-kryptonite = "^${LAYERDIR}/"
BBFILE_PRIORITY_meta-kryptonite = "6"

LAYERDEPENDS_meta-kryptonite = "core"
LAYERSERIES_COMPAT_meta-kryptonite = "dunfell"
```

## conf/machine/kryptonite.conf
```bitbake
require conf/machine/include/qemu.inc
DEFAULTTUNE ?= "core2-64"
require conf/machine/include/tune-core2.inc

MACHINE_FEATURES += "x86 pci"

PREFERRED_PROVIDER_virtual/kernel = "linux-dummy"
IMAGE_FSTYPES = "tar.bz2"
```
